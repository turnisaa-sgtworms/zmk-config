#include "pueo.dtsi"

&default_transform {
	col-offset = <13>;
};

/ {
	chosen {
		zmk,kscan = &kscan_facedown;
    };
	kscan_facedown: kscan_facedown {
		compatible = "zmk,kscan-gpio-direct";
		wakeup-source;

		input-gpios
		= <&pro_micro 9  (GPIO_ACTIVE_LOW | GPIO_PULL_UP)>
		, <&pro_micro 7  (GPIO_ACTIVE_LOW | GPIO_PULL_UP)>
		, <&pro_micro 4  (GPIO_ACTIVE_LOW | GPIO_PULL_UP)>
		, <&pro_micro 18 (GPIO_ACTIVE_LOW | GPIO_PULL_UP)>
		, <&pro_micro 8  (GPIO_ACTIVE_LOW | GPIO_PULL_UP)>
		, <&pro_micro 6  (GPIO_ACTIVE_LOW | GPIO_PULL_UP)>
		, <&pro_micro 3  (GPIO_ACTIVE_LOW | GPIO_PULL_UP)>
		, <&pro_micro 15 (GPIO_ACTIVE_LOW | GPIO_PULL_UP)>
		, <&pro_micro 16 (GPIO_ACTIVE_LOW | GPIO_PULL_UP)>
		, <&pro_micro 5  (GPIO_ACTIVE_LOW | GPIO_PULL_UP)>
		, <&pro_micro 2  (GPIO_ACTIVE_LOW | GPIO_PULL_UP)>
		, <&pro_micro 14 (GPIO_ACTIVE_LOW | GPIO_PULL_UP)>
		, <&pro_micro 10 (GPIO_ACTIVE_LOW | GPIO_PULL_UP)>
		;
	};
};
