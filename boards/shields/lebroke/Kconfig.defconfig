## boards/shields/lebroke/Kconfig.defconfig
```kconfig
CONFIG_ZMK_HID_REPORT_TYPE_NKRO = y

config ZMK_PM_SOFT_OFF
	default y

if SHIELD_LEBROKE

config ZMK_KEYBOARD_NAME
	default "lebroke"

endif
```

## boards/shields/ocarina/Kconfig.defconfig
```kconfig
CONFIG_ZMK_HID_REPORT_TYPE_NKRO = y

config ZMK_PM_SOFT_OFF
	default y

if SHIELD_OCARINA

config ZMK_KEYBOARD_NAME
	default "ocarina"

endif
```

## boards/shields/pocketpilot/Kconfig.defconfig
```kconfig
CONFIG_ZMK_HID_REPORT_TYPE_NKRO = y

config ZMK_PM_SOFT_OFF
	default y

if SHIELD_POCKETPILOT

config ZMK_KEYBOARD_NAME
	default "pocketpilot"

endif
```

## boards/shields/pueo/Kconfig.defconfig
```kconfig
config ZMK_PM_SOFT_OFF
	default y
config ZMK_POINTING
	default y

if SHIELD_PUEO_DONGLE

config ZMK_KEYBOARD_NAME
    default "pueo"

config ZMK_SPLIT_ROLE_CENTRAL
    default y

config ZMK_SPLIT
    default y

config ZMK_SPLIT_BLE_CENTRAL_PERIPHERALS
    default 2

config BT_MAX_CONN
    default 5

config BT_MAX_PAIRED
    default 5

endif

if SHIELD_PUEO_LEFT || SHIELD_PUEO_RIGHT

config ZMK_SPLIT
	default y

endif
```

## boards/shields/pueo/Kconfig.shield
```kconfig
config SHIELD_PUEO_DONGLE
	def_bool $(shields_list_contains,pueo_dongle)
config SHIELD_PUEO_LEFT
      def_bool $(shields_list_contains,pueo_left)
config SHIELD_PUEO_RIGHT
      def_bool $(shields_list_contains,pueo_right)
```

## boards/shields/swagboard/Kconfig.defconfig
```kconfig
if SHIELD_SWAGBOARD_LEFT

# Name must be less than 16 characters long!
config ZMK_KEYBOARD_NAME
    default "swagboard"

config ZMK_SPLIT_ROLE_CENTRAL
    default y

endif

if SHIELD_SWAGBOARD_LEFT || SHIELD_SWAGBOARD_RIGHT

config ZMK_SPLIT
    default y

endif

if SHIELD_SWAGBOARD_DONGLE

# Name must be less than 16 characters long!
config ZMK_KEYBOARD_NAME
    default "swagboard"

config ZMK_SPLIT
    default y

config ZMK_SPLIT_ROLE_CENTRAL
    default y

config ZMK_SPLIT_BLE_CENTRAL_PERIPHERALS
    default 2

config BT_MAX_CONN
    default 7

config BT_MAX_PAIRED
    default 7

endif
```

## boards/shields/swagboard/Kconfig.shield
```kconfig
config SHIELD_SWAGBOARD_LEFT
    def_bool $(shields_list_contains,swagboard_left)

config SHIELD_SWAGBOARD_RIGHT
    def_bool $(shields_list_contains,swagboard_right)

config SHIELD_SWAGBOARD_DONGLE
    def_bool $(shields_list_contains,swagboard_dongle)
```

## boards/shields/twenny/Kconfig.defconfig
```kconfig
config ZMK_PM_SOFT_OFF
	default y
config ZMK_POINTING
	default y

if SHIELD_TWENNY_DONGLE

config ZMK_KEYBOARD_NAME
    default "twenny"

config ZMK_SPLIT_ROLE_CENTRAL
    default y

config ZMK_SPLIT
    default y

config ZMK_SPLIT_BLE_CENTRAL_PERIPHERALS
    default 2

config BT_MAX_CONN
    default 2

config BT_MAX_PAIRED
    default 2

endif

if SHIELD_TWENNY_LEFT || SHIELD_TWENNY_RIGHT

config ZMK_SPLIT
	default y

endif
```

## boards/shields/twenny/Kconfig.shield
```kconfig
config SHIELD_TWENNY_DONGLE
    def_bool $(shields_list_contains,twenny_dongle)
config SHIELD_TWENNY_LEFT
	def_bool $(shields_list_contains,twenny_left)
config SHIELD_TWENNY_RIGHT
	def_bool $(shields_list_contains,twenny_right)
```

## config/west.yml
```yaml
manifest:
  remotes:
    - name: zmk
      url-base: https://github.com/zmkfirmware
    - name: urob
      url-base: https://github.com/urob
    - name: newx-it
      url-base: https://github.com/newx-it
  projects:
    - name: zmk
      remote: zmk
      revision: v0.3
      import: app/west.yml
    - name: zmk-auto-layer
      remote: urob
      revision: v0.3 # set to same version as zmk above
    - name: zmk-adaptive-key
      remote: urob
      revision: v0.3 # set to same as ZMK version above
    - name: zmk-unicode
      remote: urob
      revision: v0.3
    - name: zmk-nice-oled
      remote: newx-it
      revision: v0.3
  self:
    path: config
```
